## west.yml
```yaml
# Copyright (c) 2023 tinyVision.ai
# SPDX-License-Identifier: MIT

manifest:
  remotes:
    - name: zephyrproject-rtos
      url-base: https://github.com/zephyrproject-rtos
    - name: tinyvision-ai-inc
      url-base: https://github.com/tinyvision-ai-inc
    - name: josuah
      url-base: https://github.com/josuah

  projects:
    - name: zephyr
      remote: zephyrproject-rtos
      revision: main
      import:
        name-allowlist: [zephyr]
```
